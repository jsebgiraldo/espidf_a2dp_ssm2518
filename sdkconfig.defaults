## sdkconfig.defaults
```kconfig
# For ESP-IDF 5.4.x

# Enable classic BT and A2DP sink
CONFIG_BT_ENABLED=y
CONFIG_BT_CLASSIC_ENABLED=y
CONFIG_BT_BLE_ENABLED=n
CONFIG_BT_SSP_ENABLED=y
CONFIG_BT_SSP_INITIAL_MODE=3
CONFIG_BT_A2D_INCLUDED=y
CONFIG_BT_A2D_SINK=y
CONFIG_A2DP_ENABLE=y

# Bluetooth memory optimization defaults
CONFIG_BT_STACK_NO_LOG=n

# Use new I2S driver (STD)
CONFIG_I2S_STD_SUPPORT=y

# Log level (info)
CONFIG_LOG_DEFAULT_LEVEL_INFO=y
```
